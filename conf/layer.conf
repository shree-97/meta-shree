## conf/layer.conf
```bitbake
# We have a conf and classes directory, add to BBPATH
BBPATH .= ":${LAYERDIR}"

# We have recipes-* directories, add to BBFILES
BBFILES += "${LAYERDIR}/recipes-*/*/*.bb \
            ${LAYERDIR}/recipes-*/*/*.bbappend"

LAYERSERIES_COMPAT_../poky-sumo/meta-shree = "sumo"

BBFILE_COLLECTIONS += "../poky-sumo/meta-shree"
BBFILE_PATTERN_../poky-sumo/meta-shree = "^${LAYERDIR}/"
BBFILE_PRIORITY_../poky-sumo/meta-shree = "6"
```
